## samples/modules/lvgl/demos/boards/odroid_go_esp32_procpu.conf
```kconfig
# Copyright 2024 Gero Schwäricke <gero.schwaericke@posteo.de>
# SPDX-License-Identifier: Apache-2.0

# Keypad and encoders demo uses 4880 byte in idle.
CONFIG_MAIN_STACK_SIZE=8192

# The input thread needs a higher priority than the main thread. Otherwise the unpress event of a
# button press that started a scrolling animation will only be send after the scrolling ended, which
# is at the end of the scrollable area.
CONFIG_MAIN_THREAD_PRIORITY=1
CONFIG_INPUT_THREAD_PRIORITY_OVERRIDE=y
CONFIG_INPUT_THREAD_PRIORITY=0

# Joystick uses adc-keys driver
CONFIG_ADC=y

# The display ILI9341 expects big-endian data via serial interface.
CONFIG_LV_COLOR_16_SWAP=y
```
